&hsi2c_5 {
	status = "okay";

	sm5451_charger: sm5451@63 {
		compatible = "siliconmitus,sm5451";
		reg = <0x63>;
	};
};

#if defined(CONFIG_SM5714_SUPPORT_SBU) || defined(CONFIG_CHARGER_S2MU106)
/* /home/dpi/qb5_8814/workspace/P4_1716/android/kernel/kmodule/battery/suwon/charger/sm5451/sm5451_charger.a33x.dtsi */
#ifdef CONFIG_CHARGER_S2MU106
&hsi2c_5 {
	samsung,no_lose_arbitration;
};
#endif

/* /home/dpi/qb5_8814/workspace/P4_1716/android/kernel/kmodule/battery/suwon/charger/sm5451/sm5451_charger.a53x.dtsi */
&sm5451_charger {
	sm5451,freq_byp = <0x1>; /* 375kHz */
#ifdef CONFIG_CHARGER_S2MU106
	sm5451,topoff = <1000>; /* DC topoff current 1000mA */
#endif
};

/* /home/dpi/qb5_8814/workspace/P4_1716/android/kernel/kmodule/battery/suwon/charger/sm5451/sm5451_charger.a33x.03.dtsi */
/* From HWID03 refer to sm5451_charger.a33x.dtsi file */
#endif
