## drivers/muic/common/Kconfig
```kconfig
#
# MUIC devices
#
# a33x
if CHARGER_S2MU106
source "drivers/muic/common/s2mu106/Kconfig"
endif

# a53x m33x
if CHARGER_SM5714
source "drivers/muic/common/sm5714/Kconfig"
endif
```
